## Tarea 3 - FSM/sdkconfig.defaults
```kconfig
CONFIG_IDF_TARGET="esp32s3"
CONFIG_FREERTOS_HZ=1000
CONFIG_ESP_WIFI_ENABLED=y
CONFIG_MQTT_PROTOCOL_311=y
CONFIG_LOG_DEFAULT_LEVEL_INFO=y
```

## Tarea 3/main/Kconfig.projbuild
```kconfig
menu "Configuracion WiFi del proyecto"

    config WIFI_SSID
        string "WiFi SSID"
        default "MiRed"
        help
            SSID de la red WiFi a la que se conectara la ESP32.

    config WIFI_PASSWORD
        string "WiFi Password"
        default "MiPassword"
        help
            Password de la red WiFi.

endmenu
```

## Tarea 4 y 5/sdkconfig.defaults
```kconfig
# Target
CONFIG_IDF_TARGET="esp32s3"

# PSRAM (útil si tu módulo la trae; no molesta si no la usas)
CONFIG_SPIRAM=y
CONFIG_SPIRAM_MODE_QUAD=y

# FreeRTOS a 1000Hz tick para timers más finos (debounce, RMT timing)
CONFIG_FREERTOS_HZ=1000

# Particiones: dejamos espacio de sobra para OTA futura (no obligatorio usarla ahora)
CONFIG_PARTITION_TABLE_CUSTOM=y
CONFIG_PARTITION_TABLE_CUSTOM_FILENAME="partitions.csv"

# WiFi / MQTT
CONFIG_ESP_WIFI_ENABLED=y
CONFIG_MQTT_PROTOCOL_311=y

# Log level de arranque razonable
CONFIG_LOG_DEFAULT_LEVEL_INFO=y
```
